## boards/ambiq/jkcare_apollo4p_blue/Kconfig.jkcare_apollo4p_blue
```kconfig
# SPDX-License-Identifier: Apache-2.0

config BOARD_JKCARE_APOLLO4P_BLUE
	select SOC_APOLLO4P_BLUE
```

## drivers/sensor/cht8305c/Kconfig
```kconfig
# SPDX-License-Identifier: Apache-2.0

config CHT8305C
	bool "Sensylink CHT8305C temperature and humidity sensor"
	default y
	depends on DT_HAS_SENSYLINK_CHT8305C_ENABLED
	select I2C
	help
	  Enable the Sensylink CHT8305C I2C temperature and humidity
	  sensor driver.
```

## sensor-drivers/Kconfig
```kconfig
# SPDX-License-Identifier: Apache-2.0

rsource "drivers/sensor/cht8305c/Kconfig"
```

## zepyhr_jkcare/boards/ambiq/jkcare_apollo4p_blue/Kconfig.defconfig
```kconfig
# SPDX-License-Identifier: Apache-2.0

if BOARD_JKCARE_APOLLO4P_BLUE

config SYS_CLOCK_HW_CYCLES_PER_SEC
	default 32768 if AMBIQ_STIMER_TIMER
	default 96000000 if CORTEX_M_SYSTICK

endif # BOARD_JKCARE_APOLLO4P_BLUE
```

## zepyhr_jkcare/boards/ambiq/jkcare_apollo4p_blue/board.yml
```yaml
board:
  name: jkcare_apollo4p_blue
  full_name: JKCare Apollo4 Plus Blue Board
  vendor: ambiq
  socs:
    - name: apollo4p_blue
```
